// T32 Mon Sep 26 16:11:00 2005

 B::
 
 BREAK.RESET
 B.S   core_illegal_interrupt /P
 
 ENDDO

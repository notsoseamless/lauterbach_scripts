// t32 Wed Oct 05 09:21:03 2005

 B::
 
 TOOLBAR ON
 STATUSBAR ON
 WINPAGE.RESET
 
 WINPAGE.CREATE P000     
 
 WINCLEAR
 WINPOS 2.75 22.063 151. 26. 33. 2. W002
 trace.chart.symbol /track /FILE
 
 WINPOS 95.375 0.4375 61. 17. 2. 1. W002
 WINTABS 33.
 GROUP
 
 WINPOS 0.25 0.3125 91. 17. 9. 1. W001
 WINTABS 32.
 trace.list /file /track
 
 WINPAGE.CREATE P001     
 
 WINCLEAR
 WINPOS 0.0 26.75 157. 20. 11. 1. W010
 WINTABS 32.
 ANALYZER.LIST /track /file
 
 WINPOS 0.0 0.625 154. 21. 17. 2. W009
 PP::ANALYZER.TIMING /track /file
 
 WINPAGE.CREATE P002     
 
 WINCLEAR
 WINPOS 81.875 0.3125 73. 46. 11. 1. W012
 WINTABS 32.
 ANALYZER.LIST /TRACK /FILE
 
 WINPOS 0.0 0.1875 77. 21. 17. 2. W010
 PP::ANALYZER.TIMING /track /file
 
 WINPOS 0.125 25.875 77. 21. 25. 2. W011
 TRACE.CHART.SYMBOL /TRACK /FILE
 
 WINPAGE.CREATE P003     
 
 WINCLEAR
 WINPOS 1.625 0.8125 153. 46. 25. 2. W005
 WINTABS 54. 52.
 trace.statistic.symbol ALL /file
 
 WINPAGE.CREATE P004     
 
 WINCLEAR
 WINPOS 2.0 0.25 76. 46. 2. 1. W006
 WINTABS 26. 26.
 SYMBOL.BROWSE.FUNCTION
 
 WINPOS 82.875 0.125 76. 46. 2. 1. W009
 WINTABS 26. 34.
 SYMBOL.BROWSE.VAR
 
 WINPAGE.CREATE P005     
 
 WINCLEAR
 WINPOS 0.875 0.375 78. 50. 2. 1. W004
 WINTABS 38.
 GROUP
 
 WINPAGE.SELECT P002     
 
 ENDDO

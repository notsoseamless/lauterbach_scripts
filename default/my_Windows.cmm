// T32 Tue Sep 27 17:11:26 2005

 B::
 
 TOOLBAR ON
 STATUSBAR ON
 WINPAGE.RESET
 
 WINPAGE.CREATE P000     
 
 WINCLEAR
 WINPOS 102.88 0.125 68. 6. 23. 1. W004
 WINTABS 13. 0. 0. 0. 0. 0. 0.
 Break.List
 
 WINPOS 102.13 32.625 67. 17. 0. 0. W003
 Var.Watch
 
 VAR.ADDWATCH HWI_One_millisecond_clock
 
 WINPOS 102.25 10.5 66. 17. 0. 1. W001
 WINTABS 26. 26.
 y.b.sm
 
 WINPOS 0.375 0.3125 97. 49. 13. 1. W002
 WINTABS 10. 10. 25. 62.
 Data.List
 
 WINPAGE.CREATE P001     
 
 WINCLEAR
 WINPOS 0.875 29.125 130. 20. 7. 1. W005
 WINTABS 32.
 Trace.List /Track
 
 WINPOS 135.38 0.25 35. 50. 2. 1. W007
 WINTABS 20.
 GROUP
 
 WINPOS 0.0 0.125 131. 24. 25. 2. W006
 Trace.Chart.sYmbol /Track
 
 WINPAGE.CREATE P002     
 
 WINCLEAR
 WINPOS 3.25 30.313 100. 19. 10. 1. W009
 WINTABS 32.
 Trace.List /Track
 
 WINPOS 108.63 30.5 64. 17. 0. 0. W005
 PP::ANALYZER.STATE 
 
 WINPOS 0.0 0.625 170. 25. 17. 2. W008
 PP::ANALYZER.TIMING /track
 
 WINPAGE.CREATE P003     
 
 WINCLEAR
 WINPOS 2.125 23.688 80. 26. 25. 2. W011
 trace.chart.SYMBOL /track
 
 WINPOS 86.5 23.625 84. 26. 11. 1. W012
 WINTABS 32.
 Trace.List /Track
 
 WINPOS 0.5 0.3125 169. 19. 17. 2. W010
 PP::ANALYZER.TIMING /track
 
 WINPAGE.SELECT P000     
 
 ENDDO

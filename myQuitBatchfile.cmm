;===============================================myQuitBatchfile.cmm===================================================
;
; Description - Used to store the individuals personal windows
; Action Button - The dialog box that appears when closing down
;
;====================================================================================================================


;====================================================================================================================
;                                              GLOBAL VARIABLES
;====================================================================================================================

;None

;====================================================================================================================
;                                               LOCAL VARIABLES
;====================================================================================================================

local &answer

;====================================================================================================================
;                                                    MAIN
;====================================================================================================================

B::

dialog.yesno "Save Windows?"
entry &answer
if &answer
(
    if SIMULATOR()
    (

        ;&cmd_line="OS.screen cleartool checkout -c ""update my personal windows"" &(Script_Dir)\&(User_Name)\my_Simulator_Windows.cmm"
        ;&cmd_line

        dialog.ok "Please CheckOut the file \gill_vob\tools\lauterbach_scripts\<yourname>\my_Simulator_Windows.cmm and THEN press OK"
        B::store &Script_Dir\&User_Name\my_Simulator_Windows.cmm w

        ;&cmd_line="OS.screen cleardlg /checkin -c ""update my personal windows"" &(Script_Dir)\&(User_Name)\my_Simulator_Windows.cmm"
        ;&cmd_line

    )
    else
    (
        B:store Z:\gill_vob\tools\lauterbach_scripts\my_Windows.cmm w
    )
    quit
)
else
(
    quit
)



;====================================================================================================================
;                                                 SUB-ROUTINES
;====================================================================================================================


; ===================================================================================================================
; Subroutine Name:
; Parameter Returned:
; Description:
; ===================================================================================================================





;===============================================myReset.cmm====================================================
;
; Description - Used to reset the PC
; Action Button - This script is attached to the 'Reset' toolbar button
;
;
;====================================================================================================================


;====================================================================================================================
;                                              GLOBAL VARIABLES
;====================================================================================================================

;None

;====================================================================================================================
;                                               LOCAL VARIABLES
;====================================================================================================================

;None

;====================================================================================================================
;                                                    MAIN
;====================================================================================================================


;======================
; CPU setup

B::
;MAP.RESET
SYSTEM.RESET
SYSTEM.MEMACCESS NEXUS
SYSTEM.CPUACCESS DENIED
SYSTEM.CPU MPC5554
SYSTEM.BDMCLOCK 4000000.
SYSTEM.OPTION DUALPORT ON
SYSTEM.OPTION DCREAD ON

if A.CONFIG.POWERTRACE()
(
   SYSTEM.OPTION DTM READ
   SYSTEM.OPTION DMADTM OFF
   SYSTEM.OPTION MCKO 1/2
)

SYSTEM.MODE up
;break.select program onchip
map.bonchip 0x00000000--0x001FFFFF
radix hex
setup.bakfile off

; initialize internal SRAM
Data.Set A:0x40000000--0x4000FFFF %Quad 0

; setup MMU for flash, RAM and register access
MMU.TLBSET 0x1 0xC0000500 0xFFF0000A 0xFFF0003F
MMU.TLBSET 0x2 0xC0000700 0x20000000 0x2000003F
MMU.TLBSET 0x3 0xC0000400 0x40000008 0x4000003F
MMU.TLBSET 0x4 0xC0000500 0xC3F00008 0xC3F0003F
MMU.TLBSET 0x5 0xC0000700 0x00000000 0x0000003F

; set BIUAPR register to make Flash memory visible for Nexus
Data.Set ASD:0xC3F88020 %Long 0x000000FF

register.set IP start
enddo





;====================================================================================================================
;                                                 SUB-ROUTINES
;====================================================================================================================


; ===================================================================================================================
; Subroutine Name:
; Parameter Returned:
; Description:
; ===================================================================================================================




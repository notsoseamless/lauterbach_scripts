;===============================================my_Save_Trace.cmm====================================================
;
; Description - Used to store trace data (*.ad) to a standard directory specified by &TraceDataRootDir in the T32.cmm file
;				Also stores Timing data  (*.tad) if PowerProbe is also plugged in
;
; Action Button - 'Save Trace'  which is the floppy disk logo
;
;====================================================================================================================
;====================================================================================================================
;                                              GLOBAL VARIABLES
;====================================================================================================================

;None

;====================================================================================================================
;                                              LOCAL VARIABLES
;====================================================================================================================

&saveFile

;====================================================================================================================
;                                                      MAIN
;====================================================================================================================

PRINT CLOCK.TIME()


;===================
; Save Trace And/Or Timing data

dialog.filew "&Trace_Data_Dir"\*.ad
entry &saveFile


if ("&saveFile"==".ad")||("&saveFile"=="")
(
    ;cancel button must have been pressed
)
else
(
   if A.CONFIG.POWERTRACE()
   (
      B::TRACE.SAVE "&(saveFile).ad"
   )
   if POWERPROBE()
   (
      PP::ANALYZER.SAVE "&(saveFile).tad"
      B::
   )
)


ENDDO



;====================================================================================================================
;                                                    SUB-ROUTINES
;====================================================================================================================


; ===================================================================================================================
; Subroutine Name:
; Parameter Returned:
; Description:
; ===================================================================================================================




